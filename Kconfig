## Kconfig
```kconfig
config UNDERDONGLE_LAYOUTS
    string "Comma-separated layout list"
    default "EN"
```

## boards/shields/underdongle_adapter/Kconfig.shield
```kconfig
config SHIELD_UNDERDONGLE_ADAPTER
    def_bool $(shields_list_contains,underdongle_adapter)
```
